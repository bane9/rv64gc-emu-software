## linux/rv64gcemu_defconfig
```kconfig
BR2_riscv=y
BR2_TOOLCHAIN_BUILDROOT_MUSL=y
BR2_PACKAGE_HOST_LINUX_HEADERS_CUSTOM_5_15=y
BR2_OPTIMIZE_3=y
BR2_STATIC_LIBS=y
BR2_TARGET_ENABLE_ROOT_LOGIN=y
BR2_ROOTFS_OVERLAY="../overlay"
BR2_LINUX_KERNEL=y
BR2_LINUX_KERNEL_CUSTOM_VERSION=y
BR2_LINUX_KERNEL_CUSTOM_VERSION_VALUE="5.15.43"
BR2_LINUX_KERNEL_USE_CUSTOM_CONFIG=y
BR2_LINUX_KERNEL_CUSTOM_CONFIG_FILE="../rv64gcemu_linux_config"
BR2_TARGET_ROOTFS_INITRAMFS=y
# BR2_TARGET_ROOTFS_TAR is not set
BR2_TARGET_OPENSBI=y
BR2_TARGET_OPENSBI_PLAT="generic"
# BR2_TARGET_OPENSBI_INSTALL_DYNAMIC_IMG is not set
BR2_PACKAGE_HOST_E2FSPROGS=y
BR2_ROOTFS_PRE_BUILD_SCRIPT="../prebuild.sh"
```
